## config/west.yml
```yaml
manifest:
  remotes:
    - name: zmkfirmware
      url-base: https://github.com/zmkfirmware
    - name: carrefinho
      url-base: https://github.com/carrefinho
    - name: rafiks
      url-base: https://github.com/rafiks
    - name: urob
      url-base: https://github.com/urob
  projects:
    - name: zmk
      remote: zmkfirmware
      revision: v0.3
      import: app/west.yml
    - name: prospector-zmk-module
      remote: carrefinho
      revision: main
    - name: zmk-helpers
      remote: urob
      revision: v0.3
  self:
    path: config
```
